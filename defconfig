## defconfig
```kconfig
# Placeholder config for now
CONFIG_CBFS_SIZE=0x1000000
CONFIG_BOARD_EMULATION_QEMU_X86_Q35=y
CONFIG_COREBOOT_ROMSIZE_KB_16384=y
CONFIG_PAYLOAD_LINUXBOOT=y
CONFIG_LINUXBOOT_COMPILE_KERNEL=y
CONFIG_LINUXBOOT_BUILD_INITRAMFS=y
```
